#include <SPI.h>
#include <Wire.h>
#include <Adafruit_GFX.h>
#include <Adafruit_SSD1306.h>

#define SCREEN_WIDTH 128 // OLED display width, in pixels
#define SCREEN_HEIGHT 64 // OLED display height, in pixels

#define OLED_RESET     4 // Reset pin # (or -1 if sharing Arduino reset pin)
#define SCREEN_ADDRESS 0x3D ///< See datasheet for Address; 0x3D for 128x64, 0x3C for 128x32
Adafruit_SSD1306 display(SCREEN_WIDTH, SCREEN_HEIGHT, &Wire, OLED_RESET);

// 'aperture science logo bitmap 1', 22x22px
#define BTMP_1_WIDTH    22
#define BTMP_1_HEIGHT   22
const unsigned char btmp_1 [] PROGMEM = {
  0xff, 0xc0, 0x00, 0x7f, 0xfe, 0x00, 0x3f, 0xff, 0x80, 0x1f, 0xff, 0xf0, 0x0f, 0xff, 0xf8, 0x07, 
  0xff, 0xfc, 0x03, 0xff, 0xfc, 0x01, 0xff, 0xfc, 0x00, 0xff, 0xfc, 0x00, 0x7f, 0xfc, 0x00, 0x3f, 
  0xfc, 0x00, 0x1f, 0xfc, 0x00, 0x0f, 0xfc, 0x00, 0x07, 0xfc, 0x00, 0x03, 0xfc, 0x00, 0x01, 0xfc, 
  0x00, 0x00, 0xfc, 0x00, 0x00, 0x7c, 0x00, 0x00, 0x3c, 0x00, 0x00, 0x1c, 0x00, 0x00, 0x0c, 0x00, 
  0x00, 0x04
};

// 'aperture science logo bitmap 2', 12x29px
#define BTMP_2_WIDTH    12
#define BTMP_2_HEIGHT   29
const unsigned char btmp_2 [] PROGMEM = {
  0xc0, 0x00, 0xe0, 0x00, 0xf0, 0x00, 0xf8, 0x00, 0xfc, 0x00, 0xfc, 0x00, 0xfe, 0x00, 0xff, 0x00, 
  0xff, 0x00, 0xff, 0x80, 0xff, 0xc0, 0xff, 0xc0, 0xff, 0xc0, 0xff, 0xe0, 0xff, 0xe0, 0xff, 0xf0, 
  0xff, 0xf0, 0xff, 0xf0, 0xff, 0xe0, 0xff, 0xc0, 0xff, 0x80, 0xff, 0x00, 0xfe, 0x00, 0xfc, 0x00, 
  0xf8, 0x00, 0xf0, 0x00, 0xe0, 0x00, 0xc0, 0x00, 0x80, 0x00
};

// 'aperture science logo bitmap 3', 22x22px
#define BTMP_3_WIDTH    22
#define BTMP_3_HEIGHT   22
const unsigned char btmp_3 [] PROGMEM = {
  0x00, 0x00, 0x04, 0x00, 0x00, 0x0c, 0x00, 0x00, 0x1c, 0x00, 0x00, 0x3c, 0x00, 0x00, 0x7c, 0x00, 
  0x00, 0xfc, 0x00, 0x01, 0xfc, 0x00, 0x03, 0xfc, 0x00, 0x07, 0xfc, 0x00, 0x0f, 0xfc, 0x00, 0x1f, 
  0xf8, 0x00, 0x3f, 0xf8, 0x00, 0x7f, 0xf8, 0x00, 0xff, 0xf8, 0x01, 0xff, 0xf8, 0x03, 0xff, 0xf0, 
  0x07, 0xff, 0xf0, 0x0f, 0xff, 0xe0, 0x1f, 0xff, 0xe0, 0x3f, 0xff, 0xe0, 0x7f, 0xff, 0xc0, 0xff, 
  0xff, 0x80
};

// 'aperture science logo bitmap 4', 29x12px
#define BTMP_4_WIDTH    29
#define BTMP_4_HEIGHT   12
const unsigned char btmp_4 [] PROGMEM = {
  0xff, 0xff, 0xff, 0xf8, 0x7f, 0xff, 0xff, 0xf8, 0x3f, 0xff, 0xff, 0xf0, 0x1f, 0xff, 0xff, 0xe0, 
  0x0f, 0xff, 0xff, 0xc0, 0x07, 0xff, 0xff, 0x80, 0x03, 0xff, 0xfe, 0x00, 0x01, 0xff, 0xfc, 0x00, 
  0x00, 0xff, 0xf0, 0x00, 0x00, 0x7f, 0xe0, 0x00, 0x00, 0x3f, 0x00, 0x00, 0x00, 0x1c, 0x00, 0x00
};

// 'aperture science logo bitmap 5', 22x22px
#define BTMP_5_WIDTH    22
#define BTMP_5_HEIGHT   22
const unsigned char btmp_5 [] PROGMEM = {
  0x80, 0x00, 0x00, 0xc0, 0x00, 0x00, 0xe0, 0x00, 0x00, 0xf0, 0x00, 0x00, 0xf8, 0x00, 0x00, 0xfc, 
  0x00, 0x00, 0xfe, 0x00, 0x00, 0xff, 0x00, 0x00, 0xff, 0x80, 0x00, 0xff, 0xc0, 0x00, 0xff, 0xe0, 
  0x00, 0xff, 0xf0, 0x00, 0xff, 0xf8, 0x00, 0xff, 0xfc, 0x00, 0xff, 0xfe, 0x00, 0xff, 0xff, 0x00, 
  0xff, 0xff, 0x80, 0x7f, 0xff, 0xc0, 0x1f, 0xff, 0xe0, 0x07, 0xff, 0xf0, 0x00, 0xff, 0xf8, 0x00, 
  0x0f, 0xfc
};

// 'aperture science logo bitmap 6', 12x29px
#define BTMP_6_WIDTH    12
#define BTMP_6_HEIGHT   29
const unsigned char btmp_6 [] PROGMEM = {
  0x00, 0x10, 0x00, 0x30, 0x00, 0x70, 0x00, 0xf0, 0x01, 0xf0, 0x03, 0xf0, 0x07, 0xf0, 0x0f, 0xf0, 
  0x1f, 0xf0, 0x3f, 0xf0, 0x7f, 0xf0, 0xff, 0xf0, 0xff, 0xf0, 0x7f, 0xf0, 0x7f, 0xf0, 0x7f, 0xf0, 
  0x3f, 0xf0, 0x3f, 0xf0, 0x1f, 0xf0, 0x1f, 0xf0, 0x0f, 0xf0, 0x0f, 0xf0, 0x07, 0xf0, 0x03, 0xf0, 
  0x01, 0xf0, 0x01, 0xf0, 0x00, 0xf0, 0x00, 0x70, 0x00, 0x10
};

// 'aperture science logo bitmap 7', 22x22px
#define BTMP_7_WIDTH    22
#define BTMP_7_HEIGHT   22
const unsigned char btmp_7 [] PROGMEM = {
  0x07, 0xff, 0xfc, 0x0f, 0xff, 0xf8, 0x0f, 0xff, 0xf0, 0x1f, 0xff, 0xe0, 0x1f, 0xff, 0xc0, 0x3f, 
  0xff, 0x80, 0x3f, 0xff, 0x00, 0x3f, 0xfe, 0x00, 0x7f, 0xfc, 0x00, 0x7f, 0xf8, 0x00, 0x7f, 0xf0, 
  0x00, 0x7f, 0xe0, 0x00, 0xff, 0xc0, 0x00, 0xff, 0x80, 0x00, 0xff, 0x00, 0x00, 0xfe, 0x00, 0x00, 
  0xfc, 0x00, 0x00, 0xf8, 0x00, 0x00, 0xf0, 0x00, 0x00, 0xe0, 0x00, 0x00, 0xc0, 0x00, 0x00, 0x80, 
  0x00, 0x00
};

// 'aperture science logo bitmap 8', 29x12px
#define BTMP_8_WIDTH    29
#define BTMP_8_HEIGHT   12
const unsigned char btmp_8 [] PROGMEM = {
  0x00, 0x00, 0xc0, 0x00, 0x00, 0x07, 0xe0, 0x00, 0x00, 0x1f, 0xf0, 0x00, 0x00, 0x7f, 0xf8, 0x00, 
  0x01, 0xff, 0xfc, 0x00, 0x03, 0xff, 0xfe, 0x00, 0x07, 0xff, 0xff, 0x00, 0x1f, 0xff, 0xff, 0x80, 
  0x3f, 0xff, 0xff, 0xc0, 0x7f, 0xff, 0xff, 0xe0, 0x7f, 0xff, 0xff, 0xf0, 0xff, 0xff, 0xff, 0xf8
};

// 'aperture science logo bitmap', 128x64px
const unsigned char btmp_9 [] PROGMEM = {
  0x00, 0x00, 0x00, 0x00, 0x00, 0x00, 0x00, 0x1f, 0xf8, 0x00, 0x00, 0x00, 0x00, 0x00, 0x00, 0x00, 
  0x00, 0x00, 0x00, 0x00, 0x00, 0x00, 0x01, 0x8f, 0xff, 0xc0, 0x00, 0x00, 0x00, 0x00, 0x00, 0x00, 
  0x00, 0x00, 0x00, 0x00, 0x00, 0x00, 0x0f, 0xc7, 0xff, 0xf0, 0x00, 0x00, 0x00, 0x00, 0x00, 0x00, 
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  0x00, 0x00, 0x00, 0x00, 0x00, 0x00, 0x00, 0x1f, 0xf8, 0x00, 0x00, 0x00, 0x00, 0x00, 0x00, 0x00
};

const int DELAY_MS = 100;
int _step = 1; // 1-9 for bitmaps 1-9

void setup() {
  Serial.begin(9600);

  // SSD1306_SWITCHCAPVCC = generate display voltage from 3.3V internally
  if(!display.begin(SSD1306_SWITCHCAPVCC, SCREEN_ADDRESS)) {
    Serial.println(F("SSD1306 allocation failed"));
    for(;;); // Don't proceed, loop forever
  }
}

void loop() {
  if(_step == 1) {
    drawMap1();
    delayAndClear(DELAY_MS, DELAY_MS, false);
  } else if(_step == 2) {
    drawMap2();
    delayAndClear(DELAY_MS, DELAY_MS, false);
  } else if(_step == 3) {
    drawMap3();
    delayAndClear(DELAY_MS, DELAY_MS, false);
  } else if(_step == 4) {
    drawMap4();
    delayAndClear(DELAY_MS, DELAY_MS, false);
  } else if(_step == 5) {
    drawMap5();
    delayAndClear(DELAY_MS, DELAY_MS, false);
  } else if(_step == 6) {
    drawMap6();
    delayAndClear(DELAY_MS, DELAY_MS, false);
  } else if(_step == 7) {
    drawMap7();
    delayAndClear(DELAY_MS, DELAY_MS, false);
  } else if(_step == 8) {
    drawMap8();
    delayAndClear(DELAY_MS, DELAY_MS, false);
  } else {
    delayAndClear(10, 500, true);
    drawMap9();
    delayAndClear(1, 1, true);
    drawMap9();
    delayAndClear(1, 1, true);
    drawMap9();
    delayAndClear(10, 10, true);
    drawMap9();
    delayAndClear(2000, 10, true);
    drawMap9();
    delayAndClear(1, 1, true);
    drawMap9();
    delayAndClear(1000, 1, true);
    drawMap9();
    delayAndClear(2000, 1, true);
    drawMap9();
    delayAndClear(1, 2000, true);
  }
  _step++;
  if(_step > 9) {
    _step = 1;
  }
}

void delayAndClear(int delayTime1, int delayTime2, bool updt) {
    delay(delayTime1);
    Serial.print("delayAndClear... ");
    display.clearDisplay();
    if(updt) {
      display.display();
    }
    Serial.println("display cleared!");
    delay(delayTime2);
}

void drawMap1() {
  Serial.println("map 1");
  // Display bitmap
  display.drawBitmap(59, 0,  btmp_1, BTMP_1_WIDTH, BTMP_1_HEIGHT, WHITE);
  display.display();
}

void drawMap2() {
  Serial.println("map 2");
  // Display bitmap
  display.drawBitmap(83, 7,  btmp_2, BTMP_2_WIDTH, BTMP_2_HEIGHT, WHITE);
  display.display();
}

void drawMap3() {
  Serial.println("map 3");
  // Display bitmap
  display.drawBitmap(74, 27,  btmp_3, BTMP_3_WIDTH, BTMP_3_HEIGHT, WHITE);
  display.display();
}

void drawMap4() {
  Serial.println("map 4");
  // Display bitmap
  display.drawBitmap(60, 51,  btmp_4, BTMP_4_WIDTH, BTMP_4_HEIGHT, WHITE);
  display.display();
}

void drawMap5() {
  Serial.println("map 5");
  // Display bitmap
  display.drawBitmap(47, 42,  btmp_5, BTMP_5_WIDTH, BTMP_5_HEIGHT, WHITE);
  display.display();
}

void drawMap6() {
  Serial.println("map 6");
  // Display bitmap
  display.drawBitmap(33, 28,  btmp_6, BTMP_6_WIDTH, BTMP_6_HEIGHT, WHITE);
  display.display();
}

void drawMap7() {
  Serial.println("map 7");
  // Display bitmap
  display.drawBitmap(32, 15,  btmp_7, BTMP_7_WIDTH, BTMP_7_HEIGHT, WHITE);
  display.display();
}

void drawMap8() {
  Serial.println("map 8");
  // Display bitmap
  display.drawBitmap(39, 1,  btmp_8, BTMP_8_WIDTH, BTMP_8_HEIGHT, WHITE);
  display.display();
}

void drawMap9() {
  Serial.println("map 9");
  // Display bitmap
  display.drawBitmap(0, 0,  btmp_9, SCREEN_WIDTH, SCREEN_HEIGHT, WHITE);
  display.display();
}
